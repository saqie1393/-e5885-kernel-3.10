## drivers/hisi/tzdriver/libhwsecurec/Kconfig
```kconfig
#
# secure function configuration
#

config TEE_LIBHWSECUREC
	bool "Huawei secure c function library"
	default y
	help
		this is a secure f function for kernel
```

## drivers/solution/Kconfig
```kconfig
config FLIGHT_MODE
        tristate "flightmode"
        default n	
	help
          flightmode driver
```

## drivers/usb/adc/Kconfig
```kconfig
config USB_ADC		
	bool "Enable ADC Feature"		
	default n		
	help		
	If you say y here, the ADC debug infomation whill be compiled.
```
